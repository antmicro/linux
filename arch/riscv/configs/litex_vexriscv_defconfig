## arch/riscv/configs/litex_vexriscv_defconfig
```kconfig
CONFIG_SYSVIPC=y
CONFIG_POSIX_MQUEUE=y
CONFIG_NO_HZ_IDLE=y
CONFIG_HIGH_RES_TIMERS=y
CONFIG_IKCONFIG=y
CONFIG_IKCONFIG_PROC=y
CONFIG_CGROUPS=y
CONFIG_CGROUP_SCHED=y
CONFIG_CFS_BANDWIDTH=y
CONFIG_CGROUP_BPF=y
CONFIG_NAMESPACES=y
CONFIG_USER_NS=y
CONFIG_CHECKPOINT_RESTORE=y
CONFIG_BLK_DEV_INITRD=y
CONFIG_EXPERT=y
CONFIG_BPF_SYSCALL=y
CONFIG_ARCH_RV32I=y
CONFIG_CMODEL_MEDANY=y
CONFIG_SMP=y
# CONFIG_RISCV_ISA_C is not set
# CONFIG_FPU is not set
# CONFIG_EFI is not set
CONFIG_JUMP_LABEL=y
# CONFIG_STRICT_KERNEL_RWX is not set
CONFIG_MODULES=y
CONFIG_MODULE_UNLOAD=y
CONFIG_NET=y
CONFIG_PACKET=y
CONFIG_PACKET_DIAG=y
CONFIG_INET=y
CONFIG_DEVTMPFS=y
CONFIG_DEVTMPFS_MOUNT=y
CONFIG_MTD=y
CONFIG_MTD_SPI_NOR=y
CONFIG_NETDEVICES=y
CONFIG_LITEX_LITEETH=y
CONFIG_SERIAL_EARLYCON_RISCV_SBI=y
CONFIG_SERIAL_LITEUART=y
CONFIG_SERIAL_LITEUART_CONSOLE=y
CONFIG_HVC_RISCV_SBI=y
CONFIG_I2C_CHARDEV=y
CONFIG_I2C_LITEX=y
CONFIG_GPIOLIB=y
CONFIG_SENSORS_LITEX_HWMON=y
CONFIG_DRM=y
CONFIG_DRM_LITEVIDEO=y
CONFIG_FB_SIMPLE=y
CONFIG_LOGO=y
CONFIG_MMC=y
CONFIG_MMC_SPI=y
CONFIG_MMC_LITEX=y
CONFIG_LITEX_SOC_CONTROLLER=y
CONFIG_IIO=y
CONFIG_SI7020=y
CONFIG_PWM=y
CONFIG_SIFIVE_PLIC=y
CONFIG_LITEX_VEXRISCV_INTC=y
CONFIG_FPGA=y
CONFIG_EXT2_FS=y
CONFIG_EXT3_FS=y
CONFIG_MSDOS_FS=y
CONFIG_VFAT_FS=y
CONFIG_TMPFS=y
CONFIG_TMPFS_POSIX_ACL=y
CONFIG_NLS_CODEPAGE_437=y
CONFIG_NLS_ASCII=y
CONFIG_NLS_ISO8859_1=y
CONFIG_CRYPTO_USER_API_HASH=y
CONFIG_PRINTK_TIME=y
```

## drivers/net/ethernet/litex/Kconfig
```kconfig
#
# LiteX device configuration
#

config NET_VENDOR_LITEX
	bool "LiteX devices"
	default y
	help
	  If you have a network (Ethernet) card belonging to this class, say Y.

	  Note that the answer to this question doesn't directly affect the
	  kernel: saying N will just cause the configurator to skip all
	  the questions about LiteX devices. If you say Y, you will be asked
	  for your specific card in the following questions.

if NET_VENDOR_LITEX

config LITEX_LITEETH
	tristate "LiteX Ethernet support"
	depends on OF && HAS_IOMEM
	depends on LITEX
	select NET_CORE
	select MII
	select PHYLIB
	help
	  LiteX is a soft system-on-chip that targets FPGAs. LiteETH is a basic
	  network device that is commonly used in LiteX designs.

endif # NET_VENDOR_LITEX
```
